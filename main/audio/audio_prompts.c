/*
 * audio_prompts.c — Playing the notification chimes.
 *
 * SPDX-License-Identifier: Unlicense OR CC0-1.0
 */

#include <stdbool.h>
#include <stdio.h>

#include "esp_log.h"

#include "audio_prompts.h"
#include "buddy_config.h"
#include "buddy_settings.h"
#include "hw_speaker.h"

static const char *TAG = "prompts";

/**
 * Where each prompt lives. These files are generated by
 * `tools/make_chimes.py` and baked into the SPIFFS storage partition — replace
 * them with your own 16 kHz stereo WAVs if you want a different personality.
 */
static const char *const s_prompt_paths[AUDIO_PROMPT_COUNT] = {
    [AUDIO_PROMPT_WAKE]       = BUDDY_PROMPT_FOLDER "/chime_wake.wav",
    [AUDIO_PROMPT_UNDERSTOOD] = BUDDY_PROMPT_FOLDER "/chime_understood.wav",
    [AUDIO_PROMPT_THINKING]   = BUDDY_PROMPT_FOLDER "/chime_thinking.wav",
    [AUDIO_PROMPT_ERROR]      = BUDDY_PROMPT_FOLDER "/chime_error.wav",
};

/** Which of the files above actually exist on this board. */
static bool s_prompt_available[AUDIO_PROMPT_COUNT];

/**
 * @brief Does this file exist?
 *
 * Opening it is the long way round, and it is deliberate. The obvious call —
 * access(path, F_OK) — DOES NOT WORK ON SPIFFS. ESP-IDF routes access() through
 * its VFS layer to a per-filesystem handler, and the SPIFFS driver does not
 * register one, so every call fails with ENOSYS no matter what is on flash.
 *
 * The failure is silent and total: it looks exactly like the file being
 * missing, which cost a long time to spot. It reported "0 of 4 chimes
 * available" on a board whose storage partition demonstrably contained all
 * four. fopen() is implemented, so this asks the question in a way SPIFFS can
 * actually answer.
 */
static bool file_is_present(const char *path)
{
    FILE *file = fopen(path, "rb");

    if (file == NULL) {
        return false;
    }

    fclose(file);
    return true;
}

esp_err_t audio_prompts_init(void)
{
    int found = 0;

    for (int i = 0; i < AUDIO_PROMPT_COUNT; i++) {
        s_prompt_available[i] = file_is_present(s_prompt_paths[i]);
        if (s_prompt_available[i]) {
            found++;
        } else {
            ESP_LOGW(TAG, "Missing chime: %s", s_prompt_paths[i]);
        }
    }

    ESP_LOGI(TAG, "%d of %d chimes available", found, AUDIO_PROMPT_COUNT);
    return ESP_OK;
}

uint8_t audio_prompts_get_available_count(void)
{
    uint8_t found = 0;
    for (int i = 0; i < AUDIO_PROMPT_COUNT; i++) {
        if (s_prompt_available[i]) {
            found++;
        }
    }
    return found;
}

void audio_prompts_play(audio_prompt_t prompt)
{
    if (prompt < 0 || prompt >= AUDIO_PROMPT_COUNT) {
        return;
    }
    if (!buddy_settings_get()->chimes_enabled) {
        return;
    }
    if (!s_prompt_available[prompt]) {
        return;
    }

    hw_speaker_play_wav_blocking(s_prompt_paths[prompt]);
}
